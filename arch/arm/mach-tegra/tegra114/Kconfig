## arch/arm/mach-tegra/tegra114/Kconfig
```kconfig
if TEGRA114

choice
	prompt "Tegra114 board select"
	optional

config TARGET_DALMORE
	bool "NVIDIA Tegra114 Dalmore evaluation board"
	select BOARD_LATE_INIT

config TARGET_TEGRATAB
	bool "NVIDIA Tegra note 7"
	select BOARD_LATE_INIT

endchoice

config SYS_SOC
	default "tegra114"

source "board/nvidia/dalmore/Kconfig"
source "board/nvidia/tegratab/Kconfig"

endif
```
